## configs/smdk2440_defconfig
```kconfig
CONFIG_ARM=y
CONFIG_SYS_TEXT_BASE=0x00000000
CONFIG_TARGET_SMDK2440=y
CONFIG_HUSH_PARSER=y
CONFIG_SYS_PROMPT="SMDK2440 # "
CONFIG_CMD_USB=y
# CONFIG_CMD_SETEXPR is not set
CONFIG_CMD_DHCP=y
CONFIG_CMD_PING=y
CONFIG_CMD_CACHE=y
CONFIG_CMD_EXT2=y
CONFIG_CMD_FAT=y
CONFIG_MTD_NOR_FLASH=y
CONFIG_CS8900=y
CONFIG_NAND_S3C2410=y
CONFIG_RTC_S3C24X0=y
CONFIG_S3C2440=y
CONFIG_S3C24X0=y
CONFIG_S3C24X0_SERIAL=y
CONFIG_SERIAL1=y
CONFIG_SMDK2440=y
CONFIG_SYS_S3C2410_NAND_HWECC=y
CONFIG_USB_OHCI=y
CONFIG_USB_OHCI_S3C24XX=y
CONFIG_ZERO_BOOTDELAY_CHECK=y
# CONFIG_SPL_BUILD is not set
CONFIG_LCD=y
CONFIG_S3C2440_LCD=y
#CONFIG_VIDEO_MX3=y
```
